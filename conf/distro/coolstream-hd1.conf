## conf/distro/coolstream-hd1.conf
```bitbake
include conf/distro/include/coolstream-hd1/default-providers.inc
include conf/distro/include/coolstream-hd1/default-versions.inc
include conf/distro/include/coolstream-hd1/default-distrovars.inc
include conf/distro/include/coolstream-hd1/default-rdepends.inc
include conf/distro/include/coolstream-hd1/${IMAGETYPE}.inc
include conf/distro/include/coolstream-hd1/world-broken.inc
include conf/distro/include/coolstream-hd1/as-needed.inc

TCMODE ?= "default"
require conf/distro/include/coolstream-hd1/tcmode-${TCMODE}.inc

TCLIBC = "glibc"
require conf/distro/include/coolstream-hd1/tclibc-glibc.inc

# Allow single libc distros to disable this code
#TCLIBCAPPEND ?= "-${TCLIBC}"
#TMPDIR .= "${TCLIBCAPPEND}"

# set the remote repository, that will be used for storing your etc folder
GIT_URL = "/media/sdb1/service/git/etc-${TCLIBC}.git"

CACHE = "${TMPDIR}/cache/${TCMODE}-${TCLIBC}${@['', '/' + str(d.getVar('MACHINE', True))][bool(d.getVar('MACHINE', True))]}${@['', '/' + str(d.getVar('SDKMACHINE', True))][bool(d.getVar('SDKMACHINE', True))]}"

USER_CLASSES ?= ""
PACKAGE_CLASSES ?= "package_ipk"
INHERIT_BLACKLIST = "blacklist"
INHERIT_DISTRO ?= "debian devshell sstate license"
INHERIT += "${PACKAGE_CLASSES} ${USER_CLASSES} ${INHERIT_DISTRO} ${INHERIT_BLACKLIST}"
```

## conf/distro/coolstream-hd1_flash.conf
```bitbake
include conf/distro/include/coolstream-hd1_flash/default-providers.inc
include conf/distro/include/coolstream-hd1_flash/default-versions.inc
include conf/distro/include/coolstream-hd1_flash/default-distrovars.inc
include conf/distro/include/coolstream-hd1/default-rdepends.inc
include conf/distro/include/coolstream-hd1_flash/tiny.inc
include conf/distro/include/coolstream-hd1_flash/world-broken.inc
include conf/distro/include/coolstream-hd1/as-needed.inc

TCMODE ?= "default"
require conf/distro/include/coolstream-hd1_flash/tcmode-${TCMODE}.inc

TCLIBC ?= "glibc"
require conf/distro/include/coolstream-hd1_flash/tclibc-glibc.inc

# Allow single libc distros to disable this code
#TCLIBCAPPEND ?= "-${TCLIBC}"
#TMPDIR .= "${TCLIBCAPPEND}"

# set the remote repository, that will be used for storing your etc folder
GIT_URL = "/media/sda1/service/git/etc-${TCLIBC}.git"

CACHE = "${TMPDIR}/cache/${TCMODE}-${TCLIBC}${@['', '/' + str(d.getVar('MACHINE', True))][bool(d.getVar('MACHINE', True))]}${@['', '/' + str(d.getVar('SDKMACHINE', True))][bool(d.getVar('SDKMACHINE', True))]}"

IMAGE_FEATURES = ""

USER_CLASSES ?= ""
INHERIT_BLACKLIST = "blacklist"
INHERIT_DISTRO ?= "debian devshell sstate license"
INHERIT += "${PACKAGE_CLASSES} ${USER_CLASSES} ${INHERIT_DISTRO} ${INHERIT_BLACKLIST}"
```

## conf/distro/coolstream-hd2.conf
```bitbake
include conf/distro/include/coolstream-hd2/default-providers.inc
include conf/distro/include/coolstream-hd2/default-versions.inc
include conf/distro/include/coolstream-hd2/${IMAGETYPE}.inc
include conf/distro/include/coolstream-hd2/default-distrovars.inc
include conf/distro/include/coolstream-hd2/default-rdepends-${TCLIBC}.inc
include conf/distro/include/coolstream-hd2/world-broken.inc
include conf/distro/include/coolstream-hd2/as-needed.inc

TCMODE ?= "default"
require conf/distro/include/coolstream-hd2/tcmode-${TCMODE}.inc

require conf/distro/include/coolstream-hd2/tclibc-${TCLIBC}.inc

# Allow single libc distros to disable this code
#TCLIBCAPPEND ?= "-${TCLIBC}"
#TMPDIR .= "${TCLIBCAPPEND}"

# set the remote repository, that will be used for storing your etc folder
GIT_URL = "/media/sda1/service/git/etc-${TCLIBC}.git"

CACHE = "${TMPDIR}/cache/${TCMODE}-${TCLIBC}${@['', '/' + str(d.getVar('MACHINE', True))][bool(d.getVar('MACHINE', True))]}${@['', '/' + str(d.getVar('SDKMACHINE', True))][bool(d.getVar('SDKMACHINE', True))]}"

USER_CLASSES ?= ""
PACKAGE_CLASSES ?= "package_ipk"
INHERIT_BLACKLIST = "blacklist"
INHERIT_DISTRO ?= "debian devshell sstate license"
INHERIT += "${PACKAGE_CLASSES} ${USER_CLASSES} ${INHERIT_DISTRO} ${INHERIT_BLACKLIST}"
```

## conf/distro/coolstream-hd2/include/default-rdepends-glibc.inc
```bitbake
RDEPENDS_winbind ?= "popt libpam"
RDEPENDS_libwinbind ?= "libpam"
RDEPENDS_swat ?= "popt libpam"
RDEPENDS_busybox ?= "libpam"
RDEPENDS_neutrino-hd ?= "luaposix tzdata cs-drivers-hd2"
RDEPENDS_neutrino-mp ?= "luaposix tzdata cs-drivers-hd2"
RDEPENDS_oscam ?= "cs-drivers-hd2"
```

## conf/distro/coolstream-hd2/include/default-versions.inc
```bitbake
#
# Default preferred versions
#
# currently usable kernel version, use the same for headers
KV = "3.10.93"
LINUXLIBCVERSION ?= "4.10"

PREFERRED_VERSION_luaposix = "31"
# Force the python versions in one place
PYTHON_BASEVERSION ?= "2.%"
PREFERRED_VERSION_python ?= "2.%"
PREFERRED_VERSION_python-native ?= "2.%"

# Force the older version of liberation-fonts until we fix the fontforge issue
PREFERRED_VERSION_liberation-fonts ?= "1.04"


PREFERRED_VERSION_opkg = "0.3%"
PREFERRED_VERSION_opkg_native = "0.3%"
```

## conf/distro/include/coolstream-hd1/default-rdepends.inc
```bitbake
RDEPENDS_winbind ?= "popt libpam"
RDEPENDS_libwinbind ?= "libpam"
RDEPENDS_swat ?= "popt libpam"
RDEPENDS_busybox ?= "libpam"
RDEPENDS_neutrino-hd ?= "luaposix tzdata cs-drivers-hd1"
RDEPENDS_neutrino-mp ?= "luaposix tzdata cs-drivers-hd1"
RDEPENDS_oscam ?= "cs-drivers-hd1"
```

## conf/distro/include/coolstream-hd1_flash/default-rdepends.inc
```bitbake
RDEPENDS_neutrino-hd ?= "luaposix tzdata cs-drivers-hd1"
RDEPENDS_neutrino-mp ?= "luaposix tzdata cs-drivers-hd1"
RDEPENDS_oscam ?= "cs-drivers-hd1"
```

## conf/distro/include/coolstream-hd2/default-rdepends-uclibc.inc
```bitbake
RDEPENDS_vim ?= "gettext-runtime"
RDEPENDS_fuse ?= ""
RDEPENDS_djmount ?= "libiconv"
DEPENDS_groff ?= ""
RDEPENDS_${PN}_groff ?= "sed"
RDEPENDS_winbind ?= "popt libpam"
RDEPENDS_libwinbind ?= "libpam"
RDEPENDS_swat ?= "popt libpam"
RDEPENDS_tar ?= ""
RDEPENDS_grep ?= ""
RDEPENDS_basefiles ?= ""
RDEPENDS_git ?= ""
RDEPENDS_gnutls-xx ?= "gettext-runtime"
RDEPENDS_gnutls-openssl ?= "gettext-runtime"
RDEPENDS_popt ?= ""
RDEPENDS_gnutls ?= "gettext-runtime"
RDEPENDS_busybox ?= "libpam"
RDEPENDS_libxml2 ?= ""
RDEPENDS_ffmpeg ?= ""
RDEPENDS_flac ?= ""
RDEPENDS_libcurl ?= "gettext-runtime"
RDEPENDS_neutrino-hd ?= "luaposix tzdata cs-drivers-hd2"
RDEPENDS_neutrino-mp ?= "luaposix tzdata cs-drivers-hd2"
RDEPENDS_neutrino-ni ?= "luaposix tzdata cs-drivers-hd2"
RDEPENDS_oscam ?= "cs-drivers-hd2"
```

## conf/distro/include/coolstream-hd2/normal.inc
```bitbake
# include packagegroups

#IMAGE_INSTALL_append += "packagegroup-custom-link"
IMAGE_INSTALL_append += "${@'packagegroup-custom-recommended' if BOXMODEL != 'link' else 'packagegroup-custom-link'}"
```

## conf/distro/include/coolstream-hd2/tiny.inc
```bitbake
#
# Blacklist packagegroups
#
INHERIT += "blacklist"
PNBLACKLIST[packagegroup-custom-full] = "does not fit in hd-1 flash memory."
PNBLACKLIST[packagegroup-custom-dev-utils] = "does not fit in hd-1 flash memory."
PNBLACKLIST[packagegroup-custom-extended] = "does not fit in hd-1 flash memory."
PNBLACKLIST[packagegroup-custom-libs] = "does not fit in hd-1 flash memory."
PNBLACKLIST[packagegroup-custom-multiuser] = "does not fit in hd-1 flash memory."
PNBLACKLIST[packagegroup-custom-sys-services] = "does not fit in hd-1 flash memory."
PNBLACKLIST[packagegroup-custom-utils] = "does not fit in hd-1 flash memory."
PNBLACKLIST[packagegroup-custom-recommended] = "does not fit in hd-1 flash memory."
```

## conf/layer.conf
```bitbake
# We have a conf and classes directory, append to BBPATH
BBPATH .= ":${LAYERDIR}"

# We have a recipes directory containing .bb and .bbappend files, add to BBFILES
BBFILES := "${BBFILES} ${LAYERDIR}/recipes*/*/*.bb \ 
            ${LAYERDIR}/recipes*/*/*.bbappend"

BBFILE_COLLECTIONS += "neutrino-hd"
BBFILE_PATTERN_neutrino-hd := "^${LAYERDIR}/"
BBFILE_PRIORITY_neutrino-hd = "10"

# we want the good jpeg lib, not the ijg stuff
PREFERRED_PROVIDER_jpeg ?= "libjpeg-turbo"
PREFERRED_VERSION_luaposix ?= "5.1.28"
# ...and the good ffmpeg...
PREFERRED_PROVIDER_ffmpeg ?= "ffmpeg"
PREFERRED_VERSION_ffmpeg ?= "2.8.6"
# to get this we need to...
LICENSE_FLAGS_WHITELIST ?= "commercial"

# Additional license directories.
LICENSE_PATH += "${LAYERDIR}/files/custom-licenses"
```
